#include "sys.h"
#include "delay.h"
#include "usart.h"
#include "12864.h"
#include "stm32f4xx.h"
#include "KEY.h"
//#include <stdlib.h>
//#include <string.h>

typedef uint8_t __UINT8_TYPE__;
__UINT8_TYPE__ MapData[] = {0x0, 0x0, 0x0, 0x0, 0x0, 0x0, 0x0, 0x0, 0x82, 0x0, 0x0, 0x0, 0x0,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 0x0,
 0x4, 0x10, 0x41, 0x4, 0x10, 0x40, 0x0, 0x41, 0x4, 0x0, 0x1, 0x4,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 0x1, 
0x0, 0x0, 0x8, 0x0, 0x20, 0x0, 0x10, 0x40, 0x0, 0x0, 0x40, 0x4,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 0x41, 0x0};
__UINT8_TYPE__ douData[] = {0x0, 0x0, 0x0, 0x0, 0x0, 0x0, 0x0, 0x0, 0x0, 0x0, 0x0, 0x0, 0x0,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 0x0, 
0x0, 0x2, 0x0, 0x0, 0x0, 0x0, 0x2, 0x8, 0x0, 0x80, 0x0, 0x0,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 0xa, 
	0xaa, 0xaa, 0x2, 0x80, 0x20, 0x82, 0x1, 0x0, 0x20, 0x10, 0x41, 0x1,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 0x0, 0x0};
__UINT8_TYPE__ ShowData[1024] = {0};
__UINT8_TYPE__ daliwan[4][4] = {{40, 23, 1, 1}, {43, 57, 1, 1}, {116, 12, 0, 1}, {122, 57, 1, 1}};
__UINT8_TYPE__ x[5] = {63, 56, 63, 70, 63}, y[5] = {62, 28, 28, 28, 33};
__UINT8_TYPE__ direction[5];
__UINT8_TYPE__ dead[5] = {0};
__UINT8_TYPE__ mydirect = 0;
int dalitime = 0;
__UINT8_TYPE__ fensantime = 20;
int score = 0;
__UINT8_TYPE__ fanxiang(__UINT8_TYPE__ a)
{
    __UINT8_TYPE__ fan[4] = {1, 0, 3, 2};
    return fan[a];
}
void changebit(__UINT8_TYPE__ x, __UINT8_TYPE__ y, __UINT8_TYPE__ *list)
{
    list[16 * y + x / 8] ^= (1 << (7 - x % 8));
}
void setbit(__UINT8_TYPE__ x, __UINT8_TYPE__ y, __UINT8_TYPE__ *list, __UINT8_TYPE__ what)
{
    if (what)
        list[16 * y + x / 8] |= (1 << (7 - x % 8));
    else
        list[16 * y + x / 8] &= ~(1 << (7 - x % 8));
}
__UINT8_TYPE__ checkbit(__UINT8_TYPE__ x, __UINT8_TYPE__ y, __UINT8_TYPE__ *list)
{
    return ((list[16 * y + x / 8] & (1 << (7 - x % 8))) == 0 ? 0 : 1);
}
void Hello(void)
{
}
// int abs(int a, int b)
// {
//     if (a > b)
//         return a - b;
//     else
//         return b - a;
// }
void update(void)
{
    static __UINT8_TYPE__ ii = 0;
    for (int i = 0; i < 1024; i++)
    {
        ShowData[i] = douData[i] | MapData[i];
    }
    for (__UINT8_TYPE__ j = 0; j < 5; j++)
    {
        if (dead[j] == 1)
            continue;
        else
        {
            ii = 1 - ii;
            setbit(x[j], y[j], ShowData, 1);
            setbit(x[j] + 1, y[j] + 1, ShowData, 1);
            setbit(x[j] - 1, y[j] - 1, ShowData, 1);
            setbit(x[j] + 1, y[j] - 1, ShowData, 1);
            setbit(x[j] - 1, y[j] + 1, ShowData, 1);
            if (dalitime == 0 || (dalitime < 50 && ii == 0) || j == 0)
            {
                setbit(x[j], y[j] + 1, ShowData, 1);
                setbit(x[j] - 1, y[j], ShowData, 1);
                setbit(x[j] + 1, y[j], ShowData, 1);
                setbit(x[j], y[j] - 1, ShowData, 1);
            }
        }
    }
    for (__UINT8_TYPE__ i = 0; i < 4; i++)
    {
        if (daliwan[i][3] == 0)
            continue;
        setbit(daliwan[i][0], daliwan[i][1], ShowData, 1);
        if (daliwan[i][2])
        {
            setbit(daliwan[i][0] - 1, daliwan[i][1], ShowData, 1);
            setbit(daliwan[i][0] + 1, daliwan[i][1], ShowData, 1);
        }
        else
        {
            setbit(daliwan[i][0], daliwan[i][1] - 1, ShowData, 1);
            setbit(daliwan[i][0], daliwan[i][1] + 1, ShowData, 1);
        }
    }
}
__UINT8_TYPE__ whats(__UINT8_TYPE__ m, __UINT8_TYPE__ n)
{
    for (__UINT8_TYPE__ i = 1; i <= 4; i++)
    {
        if (m == x[i] && n == y[i] && !dead[i])
            return 1;
    }
    if (checkbit(m, n, douData))
        return 2;
    if (checkbit(m, n, MapData))
        return 3;
    for (__UINT8_TYPE__ i = 0; i < 4; i++)
    {
        if (m == daliwan[i][0] && n == daliwan[i][1] && daliwan[i][3] != 0)
        {
            return 4;
        }
    }
    return 0;
} //0blank 1guai 2douzi 3wall 4daliwan
__UINT8_TYPE__ zq(int x, int y)
{
    for (int i = -2; i <= 2; i++)
    {
        for (int j = -2; j <= 2; j++)
        {
            if (whats(x + i, y + j) == 3)
                return 1;
            if (x + i < 0 || x + i > 127)
                return 1;
            if (y + j < 0 || y + j > 63)
                return 1;
        }
    }
    return 0;
}
int deltax(__UINT8_TYPE__ direction)
{
    switch (direction)
    {
    case 0:
        return 0;
    case 1:
        return 0;
    case 2:
        return -1;
    case 3:
        return 1;
    }
}
int deltay(__UINT8_TYPE__ direction)
{
    switch (direction)
    {
    case 0:
        return -1;
    case 1:
        return 1;
    case 2:
        return 0;
    case 3:
        return 0;
    }
}
__UINT8_TYPE__ zoulu(__UINT8_TYPE__ keydown, __UINT8_TYPE__ newdirection)
{ //0up 1down 2left 3 right
    if (keydown)
    {
        __UINT8_TYPE__ newx = x[0] + deltax(newdirection), newy = y[0] + deltay(newdirection);

        if (!zq(newx, newy))
        {
            __UINT8_TYPE__ what = whats(newx, newy);

            switch (what)
            {
            case 4:
                for (__UINT8_TYPE__ i = 0; i < 4; i++)
                {
                    if (daliwan[i][0] == newx && daliwan[i][1] == newy)
                    {
                        daliwan[i][3] = 0;
                        break;
                    }
                }
                for (__UINT8_TYPE__ i = 1; i <= 4; i++)
                {
                    direction[i] = fanxiang(direction[i]);
                }

                x[0] = newx;
                y[0] = newy;
                direction[0] = newdirection;
                dalitime = 500;
                break;
            case 2:
                setbit(newx, newy, douData, 0);
                score++;
                //char str[30];
                //sprintf(str, "title score=%d", score);
                //system(str);
                x[0] = newx;
                y[0] = newy;
                direction[0] = newdirection;
                break;
            case 0:
                x[0] = newx;
                y[0] = newy;
                direction[0] = newdirection;
                break;
            case 1:
                if (dalitime > 0)
                {
                    for (__UINT8_TYPE__ i = 1; i <= 4; i++)
                    {
                        if (x[i] == newx && y[i] == newy)
                        {
                            dead[i] = 1;
                            score += 20;
                            break;
                        }
                    }
                }
                else
                {
									  char str[30];
										sprintf(str, "Your score=%d", score);
                    lcd_wstr(2,1,"You died.");
									  lcd_wstr(3,1,str);
										return 1;
                    //system("pause");
                    //exit(0);
                }
                break;
            }
        }
    }
		return 0;
}
__UINT8_TYPE__ autoi()
{

    int targetx[5], targety[5];
    if (fensantime > 0)
    {
        targetx[1] = 127;
        targety[1] = 0;
        targetx[2] = 127;
        targety[2] = 0;
        targetx[3] = 0;
        targety[3] = 0;
        targetx[4] = 0;
        targety[4] = 0;
    }
    else
    {
        targetx[1] = x[0];
        targety[1] = y[0];
        targetx[2] = 2 * x[0] - x[1];
        targety[2] = 2 * y[0] - y[1];
        targetx[3] = x[0] + 8 * deltax(direction[0]);
        targety[3] = y[0] + 8 * deltay(direction[0]);
        if (abs(x[4] - x[0]) + abs(y[4] - y[0]) > 32)
        {
            targetx[4] = x[0];
            targety[4] = y[0];
        }
        else
        {
            targetx[4] = 0;
            targety[4] = 0;
        }
    }
    for (__UINT8_TYPE__ i = 1; i <= 4; i++)
    {
        if (dead[i])
            continue;
        int bestdirection;
        int bestdist = dalitime > 0 ? 0 : 255;
        for (__UINT8_TYPE__ j = 0; j < 4; j++)
        {
            int newx = x[i] + deltax(j);
            int newy = y[i] + deltay(j);
            if (zq(newx, newy))
                continue;

            if (dalitime == 0)
            {
                int thisdist = abs(newx - targetx[i]) + abs(newy - targety[i]);
                if (fanxiang(j) == direction[i])
                    thisdist += 30;
                if (thisdist < bestdist)
                {
                    bestdist = thisdist;
                    bestdirection = j;
                }
            }
            else
            {
                int thisdist = rand();
                if (fanxiang(j) == direction[i])
                    thisdist = 1;
                if (thisdist > bestdist)
                {
                    bestdist = thisdist;
                    bestdirection = j;
                }
            }
        }
        x[i] += deltax(bestdirection);
        y[i] += deltay(bestdirection);
        direction[i] = bestdirection;
        if (x[i] == x[0] && y[i] == y[0])
        {
            if (dalitime > 0)
            {
                dead[i] = 1;
            }
            else
            {
                char str[30];
								sprintf(str, "Your score=%d", score);
                lcd_wstr(2,1,"You died.");
								lcd_wstr(3,1,str);
							return 1;
                //system("pause");
                //exit(0);
            }
        }
    }
    if (fensantime == 1)
    {
        fensantime = 0;
        for (__UINT8_TYPE__ i = 0; i < 5; i++)
        {
            setbit(61 + i, 21, MapData, 1);
        }
    }
    else if (fensantime > 0)
        fensantime--;
    if (dalitime > 0)
        dalitime--;
		return 0;
}

int main(void)
{ 
	delay_init(168);		  //初始化延时函数
//	NVIC_PriorityGroupConfig(NVIC_PriorityGroup_2);//设置系统中断优先级分组2
  pcb_Init();
  delay_ms(20);
  lcd_clear();
  delay_ms(10);
	KEY_Init();
	int count = 0;
	while (1)
    {
			int status = 0;
        if (SW0 == 0)
        {
            status = zoulu(1, 0);
        }
        else if (SW1 == 0)
        {
            status = zoulu(1, 1);
        }
        else if (SW2 == 0)
        {
            status = zoulu(1, 2);
        }
        else if (SW3 == 0)
        {
            status = zoulu(1, 3);
        }
        autoi();
        update();
				delay_ms(20);
				if (status == 1){
				delay_ms(60000);
					break;
				}
				if (count%10==0&&status==0){
        LCD_Display_Picture(ShowData);
				delay_ms(1000);
				}
				
				count+=1;
    }
}
